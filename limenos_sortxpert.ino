//////////////////////////////////////////////////////////////////////////////////////////////////////////////////////////////////////////////////////////////////
// RESEARCH DRIVEN PROJECT - RWTH - CONSTRUCTION ROBOTICS
// 
// CREATORS: Görkem Can Ertemli, Gizem Erekinci Altan, Georgi Tsakov
//////////////////////////////////////////////////////////////////////////////////////////////////////////////////////////////////////////////////////////////////

//////////////////////////////////////////////////////////////////////////////////////////////////////////////////////////////////////////////////////////////////
//
// INCLUSIONS / LIBRARIES
//
//////////////////////////////////////////////////////////////////////////////////////////////////////////////////////////////////////////////////////////////////

#include <AccelStepper.h>
#include <ArduinoJson.h>
#include "EspMQTTClient.h"
#include <SPI.h>
#include <Wire.h>
#include <Adafruit_GFX.h>
#include <Adafruit_SSD1306.h>


//////////////////////////////////////////////////////////////////////////////////////////////////////////////////////////////////////////////////////////////////
//
// Wifi and MQTT Data
// Please Change according to your wifi setup
//////////////////////////////////////////////////////////////////////////////////////////////////////////////////////////////////////////////////////////////////

EspMQTTClient client(
  "Limenos",                      // Wifi Name 
  "prototype",                    // Wifi Password 
  "mqtt-dashboard.com",           // MQTT Broker server ip local / "127.0.0.1" for localhosting
  "rdp_rebardev",                 // Client name that uniquely identify your device
  1883                            // The MQTT port, default to 1883. this line can be omitted
);


//////////////////////////////////////////////////////////////////////////////////////////////////////////////////////////////////////////////////////////////////
//
// Defs
//
//////////////////////////////////////////////////////////////////////////////////////////////////////////////////////////////////////////////////////////////////

#define DIR_PIN D6                // DIR
#define STEP_PIN D5               // STEP 
#define SWITCH_PIN D7             // Limit Switch

#define YLED_PIN D0               // Yellow LED
#define GLED_PIN D3               // Green LED
#define RLED_PIN D4               // RED LED

#define SCREEN_WIDTH 128          // OLED display width, in pixels
#define SCREEN_HEIGHT 32          // OLED display height, in pixels

// Declaration for an SSD1306 display connected to I2C (SDA, SCL pins)
// The pins for I2C are defined by the Wire-library. 
// On an arduino UNO:       A4(SDA), A5(SCL)
// On an arduino MEGA 2560: 20(SDA), 21(SCL)
// On an arduino LEONARDO:   2(SDA),  3(SCL), ...

// On an NodeMCU:   D2(SDA),  D1(SCK), ...

#define OLED_RESET     -1         // Reset pin # (or -1 if sharing Arduino reset pin)
#define SCREEN_ADDRESS 0x3C       // < See datasheet for Address; 0x3D for 128x64, 0x3C for 128x32
Adafruit_SSD1306 display(SCREEN_WIDTH, SCREEN_HEIGHT, &Wire, OLED_RESET);

// Values
long int ACCL;                    // Acceleration
long int MAX_SPEED;               // Top speed
String value;                     
String command;


// Logo definition
// Here we are creating a bitmap of our logo to animate it on the screen
#define LOGO_HEIGHT   32
#define LOGO_WIDTH    128
const unsigned char logo_bmp[] = {
0xff, 0xff, 0xff, 0xff, 0xff, 0xff, 0xff, 0xff, 0xff, 0xff, 0xff, 0xff, 0xff, 0xff, 0xff, 0xff, 
0xff, 0xff, 0xff, 0xff, 0xff, 0xff, 0xff, 0xff, 0xff, 0xff, 0xff, 0xff, 0xff, 0xff, 0xff, 0xff, 
0xff, 0xff, 0xff, 0xff, 0xff, 0xff, 0xff, 0xff, 0xff, 0xff, 0xff, 0xff, 0xff, 0xff, 0xff, 0xff, 
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0xff, 0xff, 0xff, 0xff, 0xff, 0xff, 0xff, 0xff, 0xff, 0xff, 0xff, 0xff, 0xff, 0xff, 0xff, 0xff
};

const unsigned char log_1[] = {
0xff, 0xff, 0xff, 0xff, 0xff, 0xff, 0xff, 0xff, 0xff, 0xff, 0xff, 0xff, 0xff, 0xff, 0xff, 0xff, 
0xff, 0xff, 0xff, 0xff, 0xff, 0xff, 0xff, 0xff, 0xff, 0xff, 0xff, 0xff, 0xff, 0xff, 0xff, 0xff, 
0xff, 0xff, 0xff, 0xff, 0xff, 0xff, 0xff, 0xff, 0xff, 0xff, 0xff, 0xff, 0xff, 0xff, 0xff, 0xff, 
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0xff, 0xff, 0xff, 0xff, 0xff, 0xff, 0xff, 0xff, 0xff, 0xff, 0xff, 0xff, 0xff, 0xff, 0xff, 0xff
};

const unsigned char log_2[] = {
0xff, 0xff, 0xff, 0xff, 0xff, 0xff, 0xff, 0xff, 0xff, 0xff, 0xff, 0xff, 0xff, 0xff, 0xff, 0xff, 
0xff, 0xff, 0xff, 0xff, 0xff, 0xff, 0xff, 0xff, 0xff, 0xff, 0xff, 0xff, 0xff, 0xff, 0xff, 0xff, 
0xff, 0xff, 0xff, 0xff, 0xff, 0xff, 0xff, 0xff, 0xff, 0xff, 0xff, 0xff, 0xff, 0xff, 0xff, 0xff, 
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0xff, 0xff, 0xff, 0xff, 0xff, 0xff, 0xff, 0xff, 0xff, 0xff, 0xff, 0xff, 0xff, 0xff, 0xff, 0xff
};

const unsigned char log_3[] = {
0xff, 0xff, 0xff, 0xff, 0xff, 0xff, 0xff, 0xff, 0xff, 0xff, 0xff, 0xff, 0xff, 0xff, 0xff, 0xff, 
0xff, 0xff, 0xff, 0xff, 0xff, 0xff, 0xff, 0xff, 0xff, 0xff, 0xff, 0xff, 0xff, 0xff, 0xff, 0xff, 
0xff, 0xff, 0xff, 0xff, 0xff, 0xff, 0xff, 0xff, 0xff, 0xff, 0xff, 0xff, 0xff, 0xff, 0xff, 0xff, 
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0xff, 0xff, 0xff, 0xff, 0xff, 0xff, 0xff, 0xff, 0xff, 0xff, 0xff, 0xff, 0xff, 0xff, 0xff, 0xff
};


// Stepper motor initiation
// '1' means DRIVER option of Accelstepper is selected
AccelStepper stepper(1, STEP_PIN, DIR_PIN);


//////////////////////////////////////////////////////////////////////////////////////////////////////////////////////////////////////////////////////////////////
//
// FUNCTIONS / VOIDs
//
//////////////////////////////////////////////////////////////////////////////////////////////////////////////////////////////////////////////////////////////////

// SETUP FUNCTION
// Initiates at the start to set up the system
void setup()
{

  Serial.begin(9600);

  pinMode(YLED_PIN, OUTPUT);
  pinMode(GLED_PIN, OUTPUT);
  pinMode(RLED_PIN, OUTPUT);

  // SSD1306_SWITCHCAPVCC = generate display voltage from 3.3V internally
  if(!display.begin(SSD1306_SWITCHCAPVCC, SCREEN_ADDRESS)) {
    Serial.println(F("SSD1306 allocation failed"));
    for(;;);        // Don't proceed, loop forever
  }

  drawchar();       // Draw letters of the default font
  drawbitmap();     // Draw a the logo

  MAX_SPEED = (MAX_SPEED == 0) ? 1600 : MAX_SPEED;
  ACCL = (ACCL == 0) ? 1600 : ACCL;
  stepper.setMaxSpeed(MAX_SPEED);
  stepper.setAcceleration(ACCL);

  pinMode(SWITCH_PIN, INPUT_PULLUP);

  home();           // Send to home and determine the home location
}

// LOOP FUNCTION
// Connect to the MQTT and keep connected
void loop()
{
   client.loop();    
   
}

// LOGO FUNCTION
// Animation of our logo
void drawbitmap(void) {
  display.clearDisplay();

  display.drawBitmap(
    (display.width()  - LOGO_WIDTH ) / 2,
    (display.height() - LOGO_HEIGHT) / 2,
    log_1, LOGO_WIDTH, LOGO_HEIGHT, 1);
  display.display();
  delay(1000);
  display.clearDisplay();

  display.drawBitmap(
    (display.width()  - LOGO_WIDTH ) / 2,
    (display.height() - LOGO_HEIGHT) / 2,
    log_2, LOGO_WIDTH, LOGO_HEIGHT, 1);
  display.display();
  delay(1000);
  display.clearDisplay();

  display.drawBitmap(
    (display.width()  - LOGO_WIDTH ) / 2,
    (display.height() - LOGO_HEIGHT) / 2,
    log_3, LOGO_WIDTH, LOGO_HEIGHT, 1);
  display.display();
  delay(1000);
  display.clearDisplay();

  display.drawBitmap(
    (display.width()  - LOGO_WIDTH ) / 2,
    (display.height() - LOGO_HEIGHT) / 2,
    logo_bmp, LOGO_WIDTH, LOGO_HEIGHT, 1);
  display.display();
  delay(1000);

}

// BOOTING FUNCTION
// Lettering for "Booting Up"
void drawchar(void) {
  display.clearDisplay();

  display.setTextSize(2);             
  display.setTextColor(SSD1306_WHITE);        // Draw white text
  display.setCursor(0, 0);             
  display.println(F("Booting"));
  display.print(F("Up..."));

  display.display();
  delay(3000);
}

// Shape FUNCTION
// Displaying what shape is being processed
void showshape(void) {
    display.clearDisplay();

    display.setTextSize(2);             
    display.setTextColor(SSD1306_WHITE);
    display.setCursor(0, 0);             
    display.println(value);
    display.print(F("Shape"));

    display.display();
    delay(4000);
}

//  HOME FUNCTION
//  Send the motor backwards for a long time or until it hits a limit switch, where it stops will be the new "0" point
void home()
{
  long int stepsToZero = 100;
  ACCL = 1600;
  MAX_SPEED = 1600;

  stepper.moveTo(-30000);

  display.clearDisplay();

  display.setTextSize(2);             
  display.setTextColor(SSD1306_WHITE);        // Draw white text
  display.setCursor(0, 0);             
  display.println(F("Going Home"));

  display.display();
  delay(100);

  while (stepper.distanceToGo() != 0)
  {
    stepper.run();
    digitalWrite(YLED_PIN, HIGH);
    // following if condition is executed if the limit switch is encountered
    if (!digitalRead(SWITCH_PIN))
    {
      digitalWrite(YLED_PIN, LOW);
      digitalWrite(RLED_PIN, HIGH);
      delay(100);
      digitalWrite(RLED_PIN, LOW);
      display.clearDisplay();

      display.setTextSize(2);             
      display.setTextColor(SSD1306_WHITE);        // Draw white text
      display.setCursor(0, 0);             
      display.println(F("Home"));
      display.println(F("Reached"));

      display.display();
      delay(100);

      stepper.setCurrentPosition(0); // sets new zero position for the motor
    }
    yield();
  }
}

// onConnectionEstablished FUNCTION
// Subscribe to topic and start recieving data from it
void onConnectionEstablished(){  
  // subscribe to the device cmd input when a connection is established
  client.subscribe("rdp/cmd/rebar", onMessageReceived);  

  analogWrite(GLED_PIN, 10); 
  delay(100);
  analogWrite(GLED_PIN, LOW); 
  delay(100); 
  analogWrite(GLED_PIN, 10); 
  delay(100);
  analogWrite(GLED_PIN, LOW); 
}

// onMessageRecieved FUNCTION
// When a message recieved this function determines what to do with the data, in our case creates a simple sorting logic
void onMessageReceived(const String &payload)
{
    Serial.println(payload);

    analogWrite(GLED_PIN, LOW); 
    delay(100);
    analogWrite(GLED_PIN, 10); 
    delay(100);
    analogWrite(GLED_PIN, LOW);

    DynamicJsonDocument doc(200);
    deserializeJson(doc, payload); // deserialize incoming payload

    command = (String)doc["cmd"];
    value = (String)doc["value"];
    
    if (command == "SetValue")
    {
        digitalWrite(GLED_PIN, HIGH);

        Serial.print("The chosen rebar is:");
        Serial.println(value);
        client.publish("rdp/read", value);

        delay(100);
        digitalWrite(GLED_PIN, LOW);

    }

    if (value == "L")
    {
       showshape();
       stepper.moveTo(0);
       digitalWrite(YLED_PIN, HIGH);
       stepper.runToPosition();
       
    
    }
    else if (value == "Z")
    {
       showshape();
       stepper.moveTo(400);
       digitalWrite(YLED_PIN, HIGH);
       stepper.runToPosition();
       
       
    }  
    else if (value == "U") 
    {
       showshape();
       stepper.moveTo(800);
       digitalWrite(YLED_PIN, HIGH);
       stepper.runToPosition();
       
      
    }
    else if (value == "I")
    {
       showshape();      
       stepper.moveTo(1200);
       digitalWrite(YLED_PIN, HIGH);
       stepper.runToPosition();
       
    }  

  digitalWrite(YLED_PIN, LOW);
}
